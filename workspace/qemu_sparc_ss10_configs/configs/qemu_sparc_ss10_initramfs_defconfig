## workspace/qemu_sparc_ss10_configs/configs/qemu_sparc_ss10_initramfs_defconfig
```kconfig
BR2_sparc=y
BR2_DEFCONFIG="$(CONFIG_DIR)/defconfig"
BR2_CCACHE=y
BR2_CCACHE_DIR="$(PWD)/../.buildroot-ccache"
BR2_ROOTFS_OVERLAY="$(PWD)/../workspace/overlay"
BR2_LINUX_KERNEL=y
BR2_LINUX_KERNEL_USE_CUSTOM_CONFIG=y
BR2_LINUX_KERNEL_CUSTOM_CONFIG_FILE="$(PWD)/../workspace/linux_sparc_ss10.config"
BR2_TARGET_ROOTFS_CPIO=y
# BR2_TARGET_ROOTFS_TAR is not set
BR2_PACKAGE_HOST_E2FSPROGS=y
BR2_PACKAGE_HOST_GENEXT2FS=y
```

## workspace/qemu_sparc_ss10_configs/configs/qemu_sparc_ss10_rootfs_defconfig
```kconfig
BR2_sparc=y
BR2_DEFCONFIG="$(CONFIG_DIR)/defconfig"
BR2_CCACHE=y
BR2_CCACHE_DIR="$(PWD)/../.buildroot-ccache"
BR2_PACKAGE_HOST_E2FSPROGS=y
BR2_PACKAGE_HOST_GENEXT2FS=y
```
